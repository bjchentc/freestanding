## CMakeLists.txt
```
cmake_minimum_required(VERSION 3.13)
find_package(Zephyr REQUIRED HINTS $ENV{ZEPHYR_BASE})

project(freestanding)

target_sources(app PRIVATE src/main.c)
```

## prj.conf
```kconfig
# CONFIG Options
# Nothing now
```

## src/main.c
```c
#include <stdio.h>

int main(void) {

    printf("Hello, my_app!\n");
    return 0;

}
```
